#include <FlipDisc.h>         // https://github.com/marcinsaj/FlipDisc
#include <RTC_RX8025T.h>      // https://github.com/marcinsaj/RTC_RX8025T
#include <TimeLib.h>          // https://github.com/PaulStoffregen/Time
#include <Wire.h>             // https://arduino.cc/en/Reference/Wire (included with Arduino IDE)
#include <OneButton.h>        // https://github.com/mathertel/OneButton
#include <EEPROM.h>           // https://www.arduino.cc/en/Reference/EEPROM


// 1. Pin declaration for a dedicated controller
#define EN_PIN  10
#define CH_PIN  A1 
#define PL_PIN  A0


// Buttons - counting from the top
#define B1_PIN A3  // Top button
#define B2_PIN A2   // Middle button

// RTC
#define RTC_PIN 2 // RTC interrupt input

#define TOP_ROW 2
#define BOT_ROW 1

// Declare structure that allows convenient access to the time elements:
// - tm.Hour - hours
// - tm.Minute - minutes
tmElements_t tm;

// Initialize a new OneButton instance for a buttons 
// BUTTON_PIN - Input pin for the button
// true      - Button is active low
// true      - Enable internal pull-up resistor
OneButton button1(B1_PIN, true, true);
OneButton button2(B2_PIN, true, true);


// Flags for storing button press status
bool shortPressButton1Status = false;
bool shortPressButton2Status = false;
bool longPressButton1Status = false;
bool longPressButton2Status = false;

// RTC interrupt flag
volatile bool interruptRtcStatus = false;


// The flag specifies whether the currently available time 
// in the tm structure is up to date. If the time is current, 
// there is no need to read the time from the RTC again
bool currentTimeStatus = false;

bool timeToDisplayTime = false;

uint8_t binaryTopRow[6];
uint8_t binaryBottomRow[6];



/************************************************************************************************/
// Interrupt from RTC
void rtcInterruptISR(void)
{
  interruptRtcStatus = true;
}



void setup() 
{
  Flip.Pin(EN_PIN, CH_PIN, PL_PIN);
  Flip.Init(D2X6);

  pinMode(RTC_PIN, INPUT_PULLUP);


  // RTC RX8025T initialization
  RTC_RX8025T.init();

  // Time update interrupt initialization. Interrupt generated by RTC (INT output): 
  // "INT_SECOND" - every second,
  // "INT_MINUTE" - every minute.
  RTC_RX8025T.initTUI(INT_MINUTE);

  // "INT_ON" - turn ON interrupt generated by RTC (INT output),
  // "INT_OFF" - turn OFF interrupt.
  RTC_RX8025T.statusTUI(INT_ON);
  
  // Assign an interrupt handler to the RTC output, 
  // an interrupt will be generated every minute to display the time
  attachInterrupt(digitalPinToInterrupt(RTC_PIN), rtcInterruptISR, FALLING);

    // Link the button functions
  button1.attachClick(ShortPressButton1);
  button2.attachClick(ShortPressButton2);
  button1.attachLongPressStart(LongPressButton1);
  button2.attachLongPressStart(LongPressButton2);

  delay(3000);
  DisplayTime();
}


void loop() 
{
  WatchButtons();
  if(interruptRtcStatus == true) DisplayTime();
  if(longPressButton1Status == true) SetTime();
  if(longPressButton2Status == true) DisplaySequence();
}




/************************************************************************************************/
// Keep watching the buttons
void WatchButtons(void)
{
  button1.tick();
  button2.tick();
}

/************************************************************************************************/
// Button press handling functions
void ShortPressButton1(void){shortPressButton1Status = true;}
void ShortPressButton2(void){shortPressButton2Status = true;}
void LongPressButton1(void){longPressButton1Status = true;}
void LongPressButton2(void){longPressButton2Status = true;}






/************************************************************************************************/
// Button flags clearing function
void ClearPressButtonFlags(void)
{
  shortPressButton1Status = false;
  shortPressButton2Status = false;
  longPressButton1Status = false;
  longPressButton2Status = false;
}







void DisplaySequence(void)
{

}





void DisplayTime(void)
{
  // Get the time from the RTC and save it to the tm structure
  RTC_RX8025T.read(tm);

  uint8_t hour_time = tm.Hour;
  uint8_t minute_time = tm.Minute;


FlipDisc::Display_2x6(uint8_t module_number, uint8_t row_number, uint8_t column_number, bool disc_status)


  DisplayData(TOP_ROW, hour_time);
  DisplayData(BOT_ROW, minute_time);
  
  DecToBinary(hour_time, binaryTopRow);
    
  for(int j = 6; j >= 1; j--)
  {
    Flip.Disc_2x6(1, j+6, binaryTopRow[6-j]);
  }

  DecToBinary(minute_time, binaryBottomRow);
    
  for(int j = 6; j >= 1; j--)
  {
    Flip.Disc_2x6(1, j, binaryBottomRow[6-j]);
  }



  interruptRtcStatus = false;
}





void DisplayTopRow(uint8_t data)
{

}












/************************************************************************************************/
void SetTime(void)
{
  ClearPressButtonFlags();

}












void DecToBinary(uint8_t decValue, uint8_t binaryArray[]) 
{
  for(int i = 0; i < 6; i++)
  {
    binaryArray[i] = decValue & B00000001;
    decValue = decValue >> 1;
  }
}
